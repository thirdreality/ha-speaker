## buildroot/package/thirdreality/python-wyoming/Config.in
```kconfig
config BR2_PACKAGE_PYTHON_WYOMING
    bool "python-wyoming"
    depends on BR2_PACKAGE_PYTHON3
    help
        Wyoming protocol library.
```

## buildroot/package/thirdreality/sendspin-client/Config.in
```kconfig
config BR2_PACKAGE_SENDSPIN_CLIENT
	bool "sendspin-client"
	depends on BR2_INSTALL_LIBSTDCPP
	depends on BR2_TOOLCHAIN_HAS_THREADS
	select BR2_PACKAGE_PORTAUDIO
	select BR2_PACKAGE_PORTAUDIO_ALSA
	select BR2_PACKAGE_AVAHI
	select BR2_PACKAGE_AVAHI_DAEMON
	select BR2_PACKAGE_AVAHI_LIBDNSSD_COMPATIBILITY
	help
	  Sendspin synchronized audio streaming client for ThirdReality speaker.
	  Uses PortAudio for audio output and avahi for mDNS discovery.

	  https://github.com/Sendspin/sendspin-cpp
```

## buildroot/package/thirdreality/tr-ledring/Config.in
```kconfig
config BR2_PACKAGE_TR_LEDRING
    bool "thirdreality ledring module"
    default n
    help
        enable thirdreality ledring module.
```

## buildroot/package/thirdreality/tr-proj-ha-speaker/Config.in
```kconfig
config BR2_PACKAGE_TR_PROJ_HA_SPEAKER
    bool "thirdreality ha speaker project"
    default n
    help
        enable thirdreality ha speaker project
```

## buildroot/package/thirdreality/tr-supervisor/Config.in
```kconfig
config BR2_PACKAGE_TR_SUPERVISOR
	bool "ThirdReality supervisor"
	depends on BR2_PACKAGE_PYTHON3
	help
        ThirdReality supervisor
```

## buildroot/package/thirdreality/webrtc-noise-gain/Config.in
```kconfig
config BR2_PACKAGE_WEBRTC_NOISE_GAIN
	bool "webrtc-noise-gain"
	depends on BR2_PACKAGE_PYTHON3
	select BR2_PACKAGE_PYTHON_WEBRTC_AUDIO_PROCESSING
	help
	  Python wrapper for WebRTC Audio Processing for noise 
	  suppression and automatic gain control.
	  
	  https://github.com/rhasspy/webrtc-noise-gain
```

## buildroot/package/thirdreality/wyoming-mic-external/Config.in
```kconfig
config BR2_PACKAGE_WYOMING_MIC_EXTERNAL
	bool "wyoming-mic-external"
    depends on BR2_PACKAGE_PYTHON_WYOMING
    default n
	help
        https://github.com/rhasspy/wyoming-mic-external
```

## buildroot/package/thirdreality/wyoming-openwakeword/Config.in
```kconfig
config BR2_PACKAGE_WYOMING_OPENWAKEWORD
	bool "wyoming-openwakeword"
    depends on BR2_PACKAGE_PYTHON_WYOMING
    default n
	help
        https://github.com/rhasspy/wyoming-openwakeword
```

## buildroot/package/thirdreality/wyoming-satellite/Config.in
```kconfig
config BR2_PACKAGE_WYOMING_SATELLITE
	bool "wyoming-satellite"
    depends on BR2_PACKAGE_PYTHON_WYOMING
    default n
	help
        https://github.com/thirdreality/wyoming-satellite
```

## buildroot/package/thirdreality/wyoming-snd-external/Config.in
```kconfig
config BR2_PACKAGE_WYOMING_SND_EXTERNAL
	bool "wyoming-snd-external"
	depends on BR2_PACKAGE_PYTHON3
	depends on BR2_PACKAGE_PYTHON_WYOMING
    default n
	help
        https://github.com/rhasspy/wyoming-snd-external
```
