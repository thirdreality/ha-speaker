## buildroot/package/amlogic/Config.in
```kconfig
menu "amlogic"
    source "package/amlogic/aml-util/Config.in"
    source "package/amlogic/aml-uboot-customer/Config.in"
    source "package/amlogic/aml_img_packer_new/Config.in"
    source "package/amlogic/aml-bootloader-message/Config.in"
    source "package/amlogic/aml-ubootenv/Config.in"
endmenu
```

## buildroot/package/amlogic/aml_img_packer_new/Config.in
```kconfig
config BR2_USE_GPT_PARTITION
	bool "Use GPT partition"
	help
        Use GPT partition
config BR2_AML_STORAGE_SIZE
	string "Storage size for makegpt cmd"
	help
        Storage size for makegpt cmd
```

## buildroot/package/android-tools5/Config.in.host
```kconfig
config BR2_PACKAGE_HOST_ANDROID_TOOLS5
	bool "host android-tools"
	select BR2_PACKAGE_HOST_ANDROID_TOOLS5_ADB if \
		!BR2_PACKAGE_HOST_ANDROID_TOOLS5_FASTBOOT
	select BR2_PACKAGE_HOST_PKGCONF
	help
	  This package contains the fastboot and adb utilities, that
	  can be used to interact with target devices using of these
	  protocols.

if BR2_PACKAGE_HOST_ANDROID_TOOLS5

config BR2_PACKAGE_HOST_ANDROID_TOOLS5_FASTBOOT
	bool "fastboot"
	depends on BR2_HOST_GCC_AT_LEAST_5 # host-libselinux -> host-libsepol
	help
	  This option will build and install the fastboot utility for
	  the host, which can be used to reflash target devices
	  implementing the fastboot protocol.

comment "fastboot needs a toolchain w/ host gcc >= 5"
	depends on !BR2_HOST_GCC_AT_LEAST_5

config BR2_PACKAGE_HOST_ANDROID_TOOLS5_ADB
	bool "adb"
	help
	  This option will build and install the adb utility for the
	  host, which can be used to interact with target devices
	  implementing the ADB protocol.

config BR2_PACKAGE_HOST_ANDROID_TOOLS5_EXT4_UTILS
	bool "ext4 utils"
	depends on BR2_HOST_GCC_AT_LEAST_5 # host-libselinux -> host-libsepol
	help
	  This option will build and install the ext4 utils for the
	  host, i.e. make_ext4fs, ext4fixup, ext2simg, img2simg,
	  simg2img and simg2simg.

comment "ext4 utils needs a toolchain w/ host gcc >= 5"
	depends on !BR2_HOST_GCC_AT_LEAST_5

endif
```

## buildroot/package/bluez_inc/Config.in
```kconfig
config BR2_PACKAGE_BLUEZ_INC
	bool
	select BR2_PACKAGE_LIBGLIB2
	help
	  provide a clean C interface to Bluez, without needing to use DBus commands.

	  https://github.com/weliem/bluez_inc
```

## buildroot/package/liblc3/Config.in
```kconfig
config BR2_PACKAGE_LIBLC3
	bool "liblc3"
	help
	  This option enables the Android liblc3 library for Bluetooth LE Audio.

	  https://github.com/google/liblc3
```

## buildroot/package/thirdreality/Config.in
```kconfig
menu "thirdreality"
#    source "package/thirdreality/wyoming-snd-external/Config.in"
#    source "package/thirdreality/wyoming-mic-external/Config.in"
#    source "package/thirdreality/wyoming-openwakeword/Config.in"
#    source "package/thirdreality/wyoming-satellite/Config.in"
#    source "package/thirdreality/python-wyoming/Config.in"
    source "package/thirdreality/pyopen-wakeword/Config.in"
    source "package/thirdreality/pyring-buffer/Config.in"
    source "package/thirdreality/amlogic-boot-fip/Config.in"
    source "package/thirdreality/broadcom/Config.in"
    source "package/thirdreality/bluez5-utils/Config.in"
    source "package/thirdreality/snapcast/Config.in"
#    source "package/thirdreality/webrtc-noise-gain/Config.in"
    source "package/thirdreality/linux-voice-assistant/Config.in"
    source "package/thirdreality/python-soundcard/Config.in"
    source "package/thirdreality/python-mpv/Config.in"
    source "package/thirdreality/python-aioesphomeapi/Config.in"
    source "package/thirdreality/python-pymicro-wakeword/Config.in"
    source "package/thirdreality/python-pymicro-features/Config.in"
    source "package/thirdreality/python-noiseprotocol/Config.in"
    source "package/thirdreality/python-chacha20poly1305-reuseable/Config.in"
    source "package/thirdreality/python-aiohappyeyeballs/Config.in"
    source "package/thirdreality/python-async-interrupt/Config.in"
    source "package/thirdreality/python-tzlocal/Config.in"

    source "package/thirdreality/tr-ledring/Config.in"
    source "package/thirdreality/tr-supervisor/Config.in"
    source "package/thirdreality/tr-proj-ha-speaker/Config.in"
endmenu
```

## buildroot/package/thirdreality/linux-voice-assistant-cpp/Config.in
```kconfig
config BR2_PACKAGE_LINUX_VOICE_ASSISTANT_CPP
	bool "linux-voice-assistant-cpp"
	depends on BR2_INSTALL_LIBSTDCPP
	depends on BR2_TOOLCHAIN_HAS_THREADS
	depends on BR2_PACKAGE_PROTOBUF_ARCH_SUPPORTS
	depends on BR2_TOOLCHAIN_GCC_AT_LEAST_4_9 # protobuf C++11 + json-for-modern-cpp
	depends on !BR2_STATIC_LIBS              # protobuf is shared-only
	select BR2_PACKAGE_PROTOBUF
	select BR2_PACKAGE_JSON_FOR_MODERN_CPP
	select BR2_PACKAGE_MPV
	select BR2_PACKAGE_PULSEAUDIO  # default audio output for libmpv
	select BR2_PACKAGE_WEBRTC_AUDIO_PROCESSING  # AGC + NS for the mic
	default n
	help
	  C++ rewrite of the linux-voice-assistant package.
	  Replaces the Python implementation with a single native
	  binary that speaks the ESPHome API to Home Assistant,
	  runs MicroWakeWord inference natively, and integrates
	  ThirdReality LED ring, mute GPIO, sound.json bridge,
	  Home button events, OTA, and the supervisor HTTP API.

	  Requires a C++20-capable toolchain (gcc >= 10).

	  This package is intended to fully replace
	  BR2_PACKAGE_LINUX_VOICE_ASSISTANT once on-device
	  verified. Do NOT enable both at the same time.

	  See: doc/linux-voice-assistant-cpp-refactor-plan.md
```

## buildroot/package/thirdreality/linux-voice-assistant/Config.in
```kconfig
config BR2_PACKAGE_LINUX_VOICE_ASSISTANT
	bool "linux voice assistant"
	depends on BR2_PACKAGE_PYTHON3
	select BR2_PACKAGE_PYTHON_AIOESPHOMEAPI
	select BR2_PACKAGE_PYTHON_NETIFACES_2
	select BR2_PACKAGE_PYTHON_SOUNDCARD
	select BR2_PACKAGE_PYTHON_NUMPY
	select BR2_PACKAGE_PYTHON_PYMICRO_WAKEWORD
	select BR2_PACKAGE_PYOPEN_WAKEWORD
	select BR2_PACKAGE_PYTHON_MPV
	select BR2_PACKAGE_PYTHON_ZEROCONF
	select BR2_PACKAGE_PYTHON_GETMAC
	select BR2_PACKAGE_PYTHON_WEBRTC_NOISE_GAIN
	default n
	help
	  Linux voice assistant for Home Assistant using the ESPHome protocol.
	  Provides wake word detection, voice pipeline, and media playback.

	  https://github.com/OHF-Voice/linux-voice-assistant
```

## buildroot/package/thirdreality/pyopen-wakeword/Config.in
```kconfig
config BR2_PACKAGE_PYOPEN_WAKEWORD
	bool "pyopen-wakeword"
	depends on BR2_PACKAGE_PYTHON3
	select BR2_PACKAGE_PYTHON_NUMPY
	help
	  Open wake word detection engine for voice assistants.

	  https://github.com/OHF-Voice/pyopen-wakeword
```

## buildroot/package/thirdreality/pyring-buffer/Config.in
```kconfig
config BR2_PACKAGE_PYRING_BUFFER
	bool "pyring-buffer"
	depends on BR2_PACKAGE_PYTHON3
	help
	  Ring buffer implementation for audio processing.

	  https://github.com/rhasspy/pyring-buffer
```

## buildroot/package/thirdreality/python-aioesphomeapi/Config.in
```kconfig
config BR2_PACKAGE_PYTHON_AIOESPHOMEAPI
	bool "python-aioesphomeapi"
	depends on BR2_PACKAGE_PYTHON3
	select BR2_PACKAGE_PYTHON_AIOHAPPYEYEBALLS
	select BR2_PACKAGE_PYTHON_ASYNC_INTERRUPT
	select BR2_PACKAGE_PYTHON_PROTOBUF
	select BR2_PACKAGE_PYTHON_TZLOCAL
	select BR2_PACKAGE_PYTHON_ZEROCONF
	select BR2_PACKAGE_PYTHON_CHACHA20POLY1305_REUSEABLE
	select BR2_PACKAGE_PYTHON_CRYPTOGRAPHY
	select BR2_PACKAGE_PYTHON_NOISEPROTOCOL
	help
	  aioesphomeapi allows you to interact with devices flashed
	  with ESPHome using the native API.

	  https://github.com/esphome/aioesphomeapi
```

## buildroot/package/thirdreality/python-aioesphomeapi/python-aioesphomeapi/Config.in
```kconfig
config BR2_PACKAGE_PYTHON_AIOESPHOMEAPI
	bool "python-aioesphomeapi"
	depends on BR2_PACKAGE_PYTHON3
	help
	  aioesphomeapi allows you to interact with devices flashed with ESPHome.
	  
	  https://github.com/esphome/aioesphomeapi
```

## buildroot/package/thirdreality/python-aiohappyeyeballs/Config.in
```kconfig
config BR2_PACKAGE_PYTHON_AIOHAPPYEYEBALLS
	bool "python-aiohappyeyeballs"
	depends on BR2_PACKAGE_PYTHON3
	help
	  Happy Eyeballs connection algorithm for asyncio.

	  https://github.com/aio-libs/aiohappyeyeballs
```

## buildroot/package/thirdreality/python-async-interrupt/Config.in
```kconfig
config BR2_PACKAGE_PYTHON_ASYNC_INTERRUPT
	bool "python-async-interrupt"
	depends on BR2_PACKAGE_PYTHON3
	help
	  Context manager to raise an exception when a future is done.

	  https://github.com/Bluetooth-Devices/async_interrupt
```

## buildroot/package/thirdreality/python-chacha20poly1305-reuseable/Config.in
```kconfig
config BR2_PACKAGE_PYTHON_CHACHA20POLY1305_REUSEABLE
	bool "python-chacha20poly1305-reuseable"
	depends on BR2_PACKAGE_PYTHON3
	select BR2_PACKAGE_PYTHON_CRYPTOGRAPHY
	help
	  Reusable ChaCha20-Poly1305 AEAD cipher for Python.

	  https://github.com/bdraco/chacha20poly1305-reuseable
```

## buildroot/package/thirdreality/python-getmac/Config.in
```kconfig
config BR2_PACKAGE_PYTHON_GETMAC
	bool "python-getmac"
	depends on BR2_PACKAGE_PYTHON3
	help
	  getmac allows you to retrieve the MAC address of network interfaces in Python.
	  
	  https://github.com/GhostofGoes/getmac
```

## buildroot/package/thirdreality/python-mpv/Config.in
```kconfig
config BR2_PACKAGE_PYTHON_MPV
	bool "python-mpv"
	depends on BR2_PACKAGE_PYTHON3
	select BR2_PACKAGE_MPV
	help
	  Python interface to the mpv media player.

	  https://github.com/jaseg/python-mpv
```

## buildroot/package/thirdreality/python-netifaces-2/Config.in
```kconfig
config BR2_PACKAGE_PYTHON_NETIFACES_2
	bool "python-netifaces-2"
	depends on BR2_PACKAGE_PYTHON3
	help
	  netifaces allows you to interact with network interfaces in Python.
	  
	  https://github.com/SamuelYvon/netifaces-2/
```

## buildroot/package/thirdreality/python-noiseprotocol/Config.in
```kconfig
config BR2_PACKAGE_PYTHON_NOISEPROTOCOL
	bool "python-noiseprotocol"
	depends on BR2_PACKAGE_PYTHON3
	select BR2_PACKAGE_PYTHON_CRYPTOGRAPHY
	help
	  Noise Protocol Framework implementation for Python.

	  https://github.com/plizonczyk/noiseprotocol
```

## buildroot/package/thirdreality/python-pymicro-features/Config.in
```kconfig
config BR2_PACKAGE_PYTHON_PYMICRO_FEATURES
	bool "python-pymicro-features"
	depends on BR2_PACKAGE_PYTHON3
	help
	  Audio feature extraction for micro wake word detection (C++ extension).

	  https://github.com/OHF-Voice/pymicro-features
```

## buildroot/package/thirdreality/python-pymicro-wakeword/Config.in
```kconfig
config BR2_PACKAGE_PYTHON_PYMICRO_WAKEWORD
	bool "python-pymicro-wakeword"
	depends on BR2_PACKAGE_PYTHON3
	select BR2_PACKAGE_PYTHON_PYMICRO_FEATURES
	select BR2_PACKAGE_PYTHON_NUMPY
	help
	  Micro wake word detection engine for voice assistants.

	  https://github.com/OHF-Voice/pymicro-wakeword
```

## buildroot/package/thirdreality/python-soundcard/Config.in
```kconfig
config BR2_PACKAGE_PYTHON_SOUNDCARD
	bool "python-soundcard"
	depends on BR2_PACKAGE_PYTHON3
	select BR2_PACKAGE_PYTHON_CFFI
	help
	  Pure-Python real-time audio library using CFFI.

	  https://github.com/bastibe/SoundCard
```

## buildroot/package/thirdreality/python-tzlocal/Config.in
```kconfig
config BR2_PACKAGE_PYTHON_TZLOCAL
	bool "python-tzlocal"
	depends on BR2_PACKAGE_PYTHON3
	help
	  Local timezone detection for Python.

	  https://github.com/regebro/tzlocal
```

## buildroot/package/thirdreality/python-webrtc-audio-processing/Config.in
```kconfig
config BR2_PACKAGE_PYTHON_WEBRTC_AUDIO_PROCESSING
	bool "python-webrtc-audio-processing"
	depends on BR2_PACKAGE_PYTHON3
	select BR2_PACKAGE_HOST_SWIG
	help
	  Python binding of WebRTC Audio Processing.
	  
	  Provides Voice Activity Detection (VAD), Noise Suppression (NS),
	  and Automatic Gain Control (AGC) functionalities.
	  
	  https://github.com/xiongyihui/python-webrtc-audio-processing

comment "python-webrtc-audio-processing needs Python3"
	depends on !BR2_PACKAGE_PYTHON3
```

## buildroot/package/thirdreality/python-webrtc-noise-gain/Config.in
```kconfig
config BR2_PACKAGE_PYTHON_WEBRTC_NOISE_GAIN
	bool "python-webrtc-noise-gain"
	depends on BR2_PACKAGE_PYTHON3
	depends on BR2_PACKAGE_PYTHON_PYBIND
	help
	  Tiny Python wrapper around webrtc-audio-processing
	  for noise suppression and auto gain only.

	  https://github.com/rhasspy/webrtc-noise-gain
```
