## buildroot/package/amlogic/aml-util/Config.in
```kconfig
config BR2_PACKAGE_AML_UTIL
	bool "aml utilities"
	depends on BR2_LINUX_KERNEL
	select BR2_PACKAGE_LIBUSB
	help
	  utilities

config BR2_INPUT_EVENTD_FILTER_POWERKEY
	bool "input_eventd powerkey-filter"
	depends on BR2_PACKAGE_AML_UTIL
	default n
	help
	  input_eventd's powerkey-filter
	  filter short continuous powerkey keystrokes

config BR2_UTILS_IOCTL
	bool "cmd_ioctl"
	depends on BR2_PACKAGE_AML_UTIL
	default n
	help
	  ioctl cmd
config BR2_AML_UTIL_SIMULATE_KEY
	bool "use the simulate_key in aml_util"
	default y
	help
	  use the simulate_key in aml_util

config BR2_UTILS_AUTO_SHUTDOWN
	bool "Auto Shutdown"
	depends on BR2_PACKAGE_AML_UTIL
	default n
	help
	  Auto Shutdown

config BR2_UTILS_BATTERY_MONITOR
	bool "Battery Monitor"
	depends on BR2_PACKAGE_AML_UTIL
	default n
	help
	  Battery Monitor
```

## buildroot/package/broadcom/Config.in
```kconfig
config BR2_PACKAGE_BROADCOM
	bool "broadcom"
	depends on BR2_LINUX_KERNEL	
	help
	  broadcom wifi firmware
```

## buildroot/package/h264bitstream/Config.in
```kconfig
config BR2_PACKAGE_H264BITSTREAM
	bool "h264bitstream"
	select BR2_PACKAGE_LIBICONV if !BR2_ENABLE_LOCALE
	# runtime UTF conversion support
	select BR2_TOOLCHAIN_GLIBC_GCONV_LIBS_COPY if BR2_TOOLCHAIN_USES_GLIBC
	help
	  h264bitstream is a self-contained library for manipulating h264 bit streams
	  https://github.com/aizvorski/h264bitstream
```

## buildroot/package/thirdreality/amlogic-boot-fip/Config.in
```kconfig
config BR2_PACKAGE_AMLOGIC_BOOT_FIP
         bool "amlogic-boot-fip"
         help
           This package enables access to various u-boot
           blobs from the LibreELEC amlogic-boot-fip repository.

           https://github.com/LibreELEC/amlogic-boot-fip

if BR2_PACKAGE_AMLOGIC_BOOT_FIP

config BR2_PACKAGE_AMLOGIC_BOOT_FIP_BOARD
        string "Board uboot firmware config"
        depends on BR2_PACKAGE_AMLOGIC_BOOT_FIP
        help
          Name of the board for which U-Boot firmware should be built 
          from amlogic-boot-fip
endif
```

## buildroot/toolchain/toolchain-external/toolchain-external-google-cros-arm-preinstalled/Config.in
```kconfig
config BR2_TOOLCHAIN_EXTERNAL_GOOGLE_CROS_ARM_PREINSTALLED
	bool "GCC ARMV7"
	depends on BR2_arm
#	depends on BR2_ARM_CPU_ARMV7A || BR2_ARM_CPU_ARMV8
	depends on !BR2_STATIC_LIBS
	select BR2_TOOLCHAIN_EXTERNAL_GLIBC
	select BR2_PACKAGE_LIBXCRYPT
	select BR2_TOOLCHAIN_HAS_SSP
	select BR2_INSTALL_LIBSTDCPP
	select BR2_TOOLCHAIN_EXTERNAL_LIBCPP
	select BR2_TOOLCHAIN_HAS_NATIVE_RPC
	select BR2_TOOLCHAIN_HEADERS_AT_LEAST_4_14
	select BR2_TOOLCHAIN_GCC_AT_LEAST_4
	help
	  Toolchain for the AArch64 architecture, from
	  Google
```
